## drivers/staging/samsung_modem_new/Kconfig
```kconfig
menuconfig SEC_MODEM
	bool "Samsung Mobile Modem Interface"
	default n
	---help---
	  Samsung Modem Interface Driver.

config UMTS_MODEM_XMM6260
	bool "modem chip : IMC XMM6260"
	depends on SEC_MODEM
	default n

config LINK_DEVICE_HSIC
	bool "modem driver link device HSIC"
	depends on SEC_MODEM
	default n
```
